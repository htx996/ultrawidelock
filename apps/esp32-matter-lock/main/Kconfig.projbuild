## apps/esp32-matter-lock/main/Kconfig.projbuild
```kconfig
menu "Example Configuration"

    config ENABLE_ULTRAWIDELOCK_BLE_UWB
        bool "Enable the credential protocol (Apple Home Key) over BLE + UWB"
        default y
        help
            Advertise the Door Lock cluster's credential Provisioning + BLE-UWB
            features and register the credential reader delegate, so Apple Home can
            provision an Express (BLE + UWB) Home Key into Wallet for this reader.

    config ENABLE_HA_MQTT
        bool "Publish distance and access events to Home Assistant over MQTT"
        default n
        depends on ENABLE_ULTRAWIDELOCK_BLE_UWB
        select ULTRAWIDELOCK_CRED_ACCESS_LISTENER
        help
            Publish UWB distance and credential access verdicts straight to a TLS
            MQTT broker, on the topics MQTT Discovery expects, so Home
            Assistant builds the device
            through MQTT Discovery with no host-side agent running. Lock
            control stays on Matter; this carries only what Matter does not
            expose.

            Off by default: it adds esp-mqtt and a TLS session to the image,
            and it is useless until a broker is provisioned. Nothing about a
            broker is compiled in — host, port, login, CA certificate and node
            name are runtime NVS config, set with the `hamqtt` console command.

            Do not set this on its own. Build with `make build HAMQTT=1`, which
            also applies the mbedTLS record sizing in
            sdkconfig.defaults.hamqtt; without it mbedtls_ssl_setup cannot get
            a contiguous 16 KiB input record next to Matter, NimBLE and Wi-Fi,
            and every connection fails with -0x7F00 before the handshake.

    menu "Two-anchor inside/outside gate"

        config ULTRAWIDELOCK_ANCHOR_BASELINE_MM
            int "Anchor separation, mm (role 1)"
            default 0
            help
                Distance between this lock and the second anchor. MEASURE IT at
                install; it is not derivable and every triangle test is sized
                from it. 0 means no satellite mounted, which leaves the verdict
                UNKNOWN and the door behaving exactly as a single-anchor lock.

                `sat_baseline <mm>` overwrites this at runtime and persists it,
                which is how the bench calibrates.

        config ULTRAWIDELOCK_ANCHOR_BASELINE_2_MM
            int "Anchor separation, mm (role 2)"
            default 0

        config ULTRAWIDELOCK_ANCHOR_BASELINE_3_MM
            int "Anchor separation, mm (role 3)"
            default 0

        config ULTRAWIDELOCK_ANCHOR_TOL_MM
            int "Triangle-inequality slack, mm"
            default 300
            help
                Size at 3 sigma of the measured per-link jitter: this gate
                catches impossible geometry, not ordinary noise. Too tight and
                every legitimate pair is rejected, which reads on a bench as a
                dead satellite rather than a misconfiguration.

        config ULTRAWIDELOCK_ANCHOR_DEADBAND_MM
            int "Half-width of the UNKNOWN band about the boundary, mm"
            default 150
            help
                Size at about 2 sigma. Within it the two distances are not far
                enough apart for their difference to have a reliable sign, and
                saying UNKNOWN beats guessing -- a phone in the doorway is
                genuinely ambiguous and should read that way.

        config ULTRAWIDELOCK_ANCHOR_BOUNDARY_BIAS_MM
            int "Shift of the side boundary toward the inside anchor, mm"
            default 0
            help
                0 keeps the boundary on the perpendicular bisector, which is the
                door plane when the anchors straddle the door -- the shipping
                install. A positive value is for a bench where both anchors sit
                on the same side of the walkway.

                IT MUST STAY SEVERAL SIGMA BELOW THE BASELINE. At bias ==
                baseline the INSIDE locus degenerates and noise decides every
                verdict.

        config ULTRAWIDELOCK_ANCHOR_STALE_MS
            int "How long a peer report stays usable, ms"
            default 1500
            help
                Past this, the satellite's distance is no longer evidence about
                where the phone is now. Expiry yields UNKNOWN, which permits --
                absence is not evidence of insideness.

        config ULTRAWIDELOCK_ANCHOR_SELF_INSIDE
            bool "This lock is the INSIDE anchor"
            default n
            help
                Which side of the door THIS board is on. A MOUNTING FACT: it
                fails no test and crashes nothing when wrong, it silently
                inverts the side verdict.

    endmenu

endmenu
```

## examples/esp32/satellite/main/Kconfig.projbuild
```kconfig
# Satellite responder options. Mirrors apps/satellite/Kconfig so the two ports
# describe the same board the same way.

menu "UltraWideLock satellite"

config ULTRAWIDELOCK_ANCHOR_ROLE
	int "Which side of the door this anchor is mounted on"
	default 2
	range 1 3
	help
	  1 = inside, 2 = outside, 3 = threshold, matching
	  enum ultrawidelock_witness_role, which the sealed link's role field
	  reuses so one demultiplexer serves every peer on the link.

	  A MOUNTING FACT, and the lock reads it to decide which distance is the
	  inside one. Getting it backwards does not crash and fails no geometry
	  test -- it silently inverts the side verdict, withholding from people
	  indoors and granting to people on the doorstep.

	  Build-time rather than provisioned: this board is screwed to one side
	  of one door, unlike the interchangeable witnesses it replaces.

	  It is also the nonce prefix this board seals with, which is why the
	  range is 1..3 and not wider: the lock claims 0xFF for its own
	  direction, and one key is safe in both directions only while those two
	  spaces cannot meet (ULTRAWIDELOCK_LINK_HANDOFF_ROLE).

endmenu
```

## integrations/nrfconnect-door-lock/matter-aliro-door-lock-app/Kconfig
```kconfig
#
# Copyright (c) 2025 Nordic Semiconductor ASA
#
# SPDX-License-Identifier: LicenseRef-Nordic-5-Clause
#

mainmenu "nRF Door Lock and Access Control Add-on"

module = DOOR_LOCK_APP
module-str = NCS_DOOR_LOCK_APP
module-dep = LOG
module-help = Enables nRF Connect SDK Door Lock Application log messages.
source "$(ZEPHYR_BASE)/subsys/logging/Kconfig.template.log_config"

config DOOR_LOCK_CLI
	bool "CLI support"
	default y if !DOOR_LOCK_RELEASE
	select SHELL
	select REBOOT
	select DOOR_LOCK_ALIRO_READER_STORAGE_SHELL
	help
	  Enable support for Door Lock CLI.

config DOOR_LOCK_RELEASE
    bool "Release configuration"
    help
      In this configuration:
      Aliro stack logs are disabled.
      RFAL NFC driver logs are disabled.
      Shell commands are disabled.
      Device reset automatically on fatal error.

config ULTRAWIDELOCK_HA
	bool "Home Assistant data model"
	depends on DOOR_LOCK_BLE_UWB
	help
	  Build the Matter data model that a Home Assistant install can use
	  directly: the Door Lock LockOperation event, and an Occupancy Sensing
	  endpoint driven by UWB proximity.

	  This selects src/matter/zap_uwb_ha in place of src/matter/zap_uwb and
	  compiles the proximity callback in bolt_lock_manager.cpp, which writes
	  the occupancy attribute on the endpoint only that data model declares.

	  Off by default because it changes the data model of an already
	  commissioned lock, and that has not been validated on hardware. It was
	  a pair of patches against the fetched application before this
	  application was ours; the ordering hazard they carried is gone with
	  them.

rsource "src/Kconfig"

rsource "Kconfig.defconfig"

# Source BLE defconfig when any BLE feature is enabled
if DOOR_LOCK_BLE_UWB || DOOR_LOCK_DFU_SMP_SERVICE || DOOR_LOCK_NUS_SERVICE
rsource "Kconfig.ble.defconfig"
endif # DOOR_LOCK_BLE_UWB || DOOR_LOCK_DFU_SMP_SERVICE || DOOR_LOCK_NUS_SERVICE

rsource "Kconfig.crypto.defconfig"

rsource "src/matter/Kconfig"
source "$(ZEPHYR_CONNECTEDHOMEIP_MODULE_DIR)/config/nrfconnect/chip-module/Kconfig.features"
source "$(ZEPHYR_CONNECTEDHOMEIP_MODULE_DIR)/config/nrfconnect/chip-module/Kconfig.defaults"
source "$(ZEPHYR_NRF_MODULE_DIR)/samples/matter/common/src/Kconfig"

source "Kconfig.zephyr"
```

## integrations/nrfconnect-door-lock/matter-aliro-door-lock-app/src/aliro/Kconfig
```kconfig
#
# Copyright (c) 2025 Nordic Semiconductor ASA
#
# SPDX-License-Identifier: LicenseRef-Nordic-5-Clause
#

menu "Aliro features"

config DOOR_LOCK_BLE_UWB
	bool "Integration with Aliro BLE and UWB"
	select NCS_ALIRO_BLE_UWB
	select DOOR_LOCK_ALIRO_UWB
	select DOOR_LOCK_ALIRO_BLE_SERVICE
	select DOOR_LOCK_ALIRO_READER_STORAGE_GROUP_RESOLVING_KEY_SUPPORT
	help
	  Enable the door lock application integration with Aliro Bluetooth LE (BLE) and ultra wideband (UWB).

if DOOR_LOCK_BLE_UWB

config DOOR_LOCK_BLE_UWB_MAX_SESSIONS
	int "Maximum number of BLE and UWB sessions"
	range 1 BT_MAX_CONN
	help
	  The maximum number of BLE and UWB sessions that can be established.

endif # DOOR_LOCK_BLE_UWB

config DOOR_LOCK_EXPEDITED_FAST_PHASE
    bool "Support for Aliro Expedited-fast Phase"
    default y
    help
        If enabled, the Expedited-fast phase is supported.
        The user authentication is based on the Kpersistent keys.

config DOOR_LOCK_STEP_UP_PHASE
    bool "Support for Aliro Step-up Phase"
    default y
    select DOOR_LOCK_ALIRO_ACCESS_DOCUMENT_PARSER
    select DOOR_LOCK_EXTERNAL_NVS if !SOC_SERIES_NRF52
    help
        If enabled, the Step-up phase is supported.
        The user authentication is based on the Access Document.

config DOOR_LOCK_CREDENTIAL_ISSUER_CA
    bool "Support for Credential Issuer CA public key"
    depends on DOOR_LOCK_STEP_UP_PHASE
    help
        If enabled, the Credential Issuer CA public key is supported.
        The Credential Issuer CA public key is used to verify the signature of the Credential Issuer certificate.

config DOOR_LOCK_READER_CERTIFICATE
	bool "Support for Reader certificates"
	select DOOR_LOCK_ALIRO_READER_STORAGE_CERTIFICATE_SUPPORT
	select DOOR_LOCK_ALIRO_READER_STORAGE_SHELL_CERT
	help
	  Use the reader certificate for the reader authentication.

config DOOR_LOCK_TIME_CONCEPT
	bool "Support for Time concept"
	default y
	select DOOR_LOCK_ALIRO_TIME_UTILS
	help
	  If enabled, the Time concept is supported.

config DOOR_LOCK_TIME_CONCEPT_RATCHET
	bool "Ratchet system time forward from a verified Access Document"
	default y
	depends on DOOR_LOCK_TIME_CONCEPT
	help
	  Access Documents are minted on demand with validFrom set to the user
	  device's current time (validUntil is effectively unbounded), so the
	  validity check degenerates into "reader clock must not be behind the
	  phone". The reader wall clock lives in RAM and the commissioner sets
	  it exactly once, so after any reboot the reader falls back to stale
	  Last Known Good Time and every step-up fails as not-yet-valid.
	  If enabled, a document whose signature has already been verified and
	  whose validFrom lies ahead of the reader clock ratchets the system
	  time forward to validFrom (never backward) instead of failing.
	  Trade-off: a credential issuer that signs a future-dated document can
	  advance the reader clock early, weakening not-before enforcement and
	  shifting schedule evaluation for time-bounded credentials. With
	  DOOR_LOCK_TIME_CONCEPT_PERSIST enabled the ratcheted clock is
	  persisted within the hour, so such an advance also survives reboot.

config DOOR_LOCK_TIME_CONCEPT_PERSIST
	bool "Persist the wall clock and restore it after reboot"
	default y
	depends on DOOR_LOCK_TIME_CONCEPT && SETTINGS
	help
	  The reader wall clock lives in RAM and the commissioner sets it
	  exactly once at commissioning, so any reboot leaves the reader
	  without valid time. If enabled, the wall clock is written to the
	  settings storage once per hour (and shortly after it first becomes
	  valid or is corrected), and the system clock is seeded from the
	  stored value at boot. After a reboot time then resumes at worst
	  one hour plus the power-off duration behind real time instead of
	  being absent. The restored clock understates real time by that
	  amount, which weakens validUntil/expiry and schedule enforcement
	  correspondingly but never moves the clock backward or forward
	  beyond what was actually observed.

endmenu # Aliro features

rsource "platform/Kconfig"
rsource "interface_impl/Kconfig"
rsource "access_manager/Kconfig"
rsource "cli/Kconfig"
rsource "kpersistent_manager/Kconfig"
rsource "storage/Kconfig"
```
